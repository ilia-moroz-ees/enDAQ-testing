VERSION "created by Ilia Moroz"

NS_ :

BS_:

BU_: PC CANEDGE

BO_ 2147483649 TEST_DATA: 8 PC
 SG_ DATA : 8|16@1+ (1,0) [0|32127.5] "UNITS"  CANEDGE

BA_DEF_ BO_  "GenMsgSendType" ENUM  "Cyclic","Reserved","Reserved","Reserved","Reserved","Reserved","Reserved","IfActive","NoMsgSendType";
BA_DEF_ BO_  "GenMsgCycleTime" INT 0 65535;
BA_DEF_ BO_  "VFrameFormat" ENUM  "StandardCAN","ExtendedCAN","reserved","J1939PG";
BA_DEF_ BO_  "CanDootDecode" ENUM  "No","Yes";
BA_DEF_ BO_  "CanDootSimulateBus" INT 0 6;
BA_DEF_ BO_  "CanDootDecodeBus" INT 0 6;
BA_DEF_ BO_  "CanDootSimulate" ENUM  "No","Yes";
BA_DEF_ BO_  "CanDootSimulateCycleTime" INT 0 50000;
BA_DEF_DEF_  "GenMsgSendType" "";
BA_DEF_DEF_  "GenMsgCycleTime" 0;
BA_DEF_DEF_  "VFrameFormat" "";
BA_DEF_DEF_  "CanDootDecode" "Yes";
BA_DEF_DEF_  "CanDootSimulateBus" 0;
BA_DEF_DEF_  "CanDootDecodeBus" 0;
BA_DEF_DEF_  "CanDootSimulate" "No";
BA_DEF_DEF_  "CanDootSimulateCycleTime" 1500;
BA_ "GenMsgSendType" BO_ 2147483649 0;
BA_ "GenMsgCycleTime" BO_ 2147483649 1000;
BA_ "CanDootSimulateBus" BO_ 2147483649 1;
BA_ "CanDootSimulate" BO_ 2147483649 1;
BA_ "CanDootSimulateCycleTime" BO_ 2147483649 100;
BA_ "CanDootDecodeBus" BO_ 2147483649 1;
BA_ "VFrameFormat" BO_ 2147483649 3;
